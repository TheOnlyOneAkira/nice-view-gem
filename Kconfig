## Kconfig
```kconfig
config ZMK_BEHAVIOR_NICE_VIEW_ANIM
    bool
    default y
    depends on DT_HAS_ZMK_BEHAVIOR_NICE_VIEW_ANIM_ENABLED
```

## dts/bindings/behaviors/zmk,behavior-nice-view-anim.yaml
```yaml
description: Change l'animation de l'écran nice!view gem (moitié périphérique)

compatible: "zmk,behavior-nice-view-anim"

include: two_param.yaml
```
